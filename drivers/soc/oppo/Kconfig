## drivers/soc/oppo/Kconfig
```kconfig
config OPPO_ARCH_FILE
    bool "for build directory oppo"
    ---help---
    say Y to buid in

config OPPO_COMMON_SOFT
        bool "config oppo common software"
        select OPPO_ARCH_FILE
        help
        define this config to get project verion from sharemem.
        Maybe this value is from CDT or dynamic identify by hardware
        id.

config OPPO_DEVICE_IFNO
        bool "config oppo devinfo"
        select OPPO_ARCH_FILE
        help
        define this config to compile devinfo.c for device register.

source "drivers/soc/oppo/oppo_project/Kconfig"
source "drivers/soc/oppo/oppo_devinfo/Kconfig"
source "drivers/soc/oppo/oppo_criticallog/Kconfig"
source "drivers/soc/oppo/oppo_hypnus/Kconfig"
source "drivers/soc/oppo/oppo_custom/Kconfig"
source "drivers/soc/oppo/oppo_als_cali_value/Kconfig"


#ifdef VENDOR_EDIT
#//Kun.Hu@PSW.TECH 2018/11/15, Add phoenix base
#source "drivers/soc/oppo/oppo_phoenix/Kconfig"
#endif /* VENDOR_EDIT */
```
